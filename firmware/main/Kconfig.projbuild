## firmware/sdkconfig.defaults.mfm384
```kconfig
# Bench profile: SELEC MFM384 — poll Total active energy (float32) at 1 Hz.
# Usage:
#   idf.py -DSDKCONFIG_DEFAULTS="sdkconfig.defaults;sdkconfig.defaults.mfm384" build flash monitor
# Confirmed on real hardware (2026-06-24): this meter uses the ETS voltage-first FC04 map and CDAB
# word order (NOT the RAK3312 reg-89/ABCD map). Total kWh = FC04 input reg 58 (per ETS param map).
# Run sdkconfig.defaults.mfm384-volt first (FC04 reg 0 = V1N ≈ live voltage) to confirm the link.
# Note: on a bench with no real load the accumulated energy may read ~0.000 kWh — that's expected.
CONFIG_APP_MODBUS_POLL_ON_BOOT=y
CONFIG_APP_MODBUS_POLL_UNIT=1
CONFIG_APP_MODBUS_POLL_BAUD=9600
CONFIG_APP_MODBUS_POLL_FC=4
CONFIG_APP_MODBUS_POLL_REG=58
CONFIG_APP_MODBUS_POLL_FLOAT=y
CONFIG_APP_MODBUS_POLL_FLOAT_CDAB=y
```

## firmware/sdkconfig.defaults.mfm384-volt
```kconfig
# Bench profile: SELEC MFM384 — poll V1N phase voltage (FC04 reg 0, float32) at 1 Hz.
# Usage:
#   idf.py -DSDKCONFIG_DEFAULTS="sdkconfig.defaults;sdkconfig.defaults.mfm384-volt" build flash monitor
# Rationale (cross-checked vs southern-rnd/ETS-LORA-Test, same RAK3112+MFM384, tested working):
# that build reads the MFM384 entirely over FC04 INPUT registers, voltage-first map (V1N @ reg 0).
# FC04 reg 0 is the best linkcheck: present + non-zero whenever the meter is powered. The raw hex
# words are logged, so word order is readable by eye (ABCD vs CDAB).
# CONFIRMED on real hardware (2026-06-24): this meter is CDAB — FC04 reg 0 CDAB = V1N ≈ 50.5 V.
# (ABCD gave garbage; the RAK3312 "ABCD" note did not hold for this physical meter.)
CONFIG_APP_MODBUS_POLL_ON_BOOT=y
CONFIG_APP_MODBUS_POLL_UNIT=1
CONFIG_APP_MODBUS_POLL_BAUD=9600
CONFIG_APP_MODBUS_POLL_FC=4
CONFIG_APP_MODBUS_POLL_REG=0
CONFIG_APP_MODBUS_POLL_FLOAT=y
CONFIG_APP_MODBUS_POLL_FLOAT_CDAB=y
```

## firmware/sdkconfig.defaults.ota-bad
```kconfig
# Phase 7c rollback-gate repro: aborts in app_main before mark-valid, so an OTA into this
# image rolls back to the previous good slot. Build/stage:
#   idf.py -DSDKCONFIG_DEFAULTS="sdkconfig.defaults;sdkconfig.defaults.ota-bad" build
# NEVER flash as the primary image.
CONFIG_APP_BUILD_TAG="BAD"
CONFIG_APP_DEBUG_OTA_BAD=y
```

## firmware/sdkconfig.defaults.poll
```kconfig
# Bench profile: MFM384 linkcheck — poll one holding register at 1 Hz (quick "is it alive").
# Usage:
#   idf.py -DSDKCONFIG_DEFAULTS="sdkconfig.defaults;sdkconfig.defaults.poll" build flash monitor
# Target: SELEC MFM384 multifunction meter — unit 1, 9600 8N1, FC03 linkcheck reg 40007 (wire 6).
# A reply with any value proves the link; swap A/B if it times out. For the float energy read use
# sdkconfig.defaults.mfm384; for the old RS-FSJT wind sensor use sdkconfig.defaults.poll-rsfsjt.
CONFIG_APP_MODBUS_POLL_ON_BOOT=y
CONFIG_APP_MODBUS_POLL_UNIT=1
CONFIG_APP_MODBUS_POLL_BAUD=9600
CONFIG_APP_MODBUS_POLL_FC=3
CONFIG_APP_MODBUS_POLL_REG=6
CONFIG_APP_MODBUS_POLL_FLOAT=n
```

## firmware/sdkconfig.defaults.poll-rsfsjt
```kconfig
# Bench profile: RS-FSJT-N01 wind-speed sensor — poll one holding register at 1 Hz.
# Usage:
#   idf.py -DSDKCONFIG_DEFAULTS="sdkconfig.defaults;sdkconfig.defaults.poll-rsfsjt" build flash monitor
# Target: RS-FSJT-N01 — unit 1, 4800 8N1, FC03 holding reg 40001 (wire 0), uint16, value / 10 = m/s.
# Kept for the original Phase 6 device; the primary bring-up target is now the MFM384 (see .poll/.mfm384).
CONFIG_APP_MODBUS_POLL_ON_BOOT=y
CONFIG_APP_MODBUS_POLL_UNIT=1
CONFIG_APP_MODBUS_POLL_BAUD=4800
CONFIG_APP_MODBUS_POLL_FC=3
CONFIG_APP_MODBUS_POLL_REG=0
CONFIG_APP_MODBUS_POLL_FLOAT=n
```

## firmware/sdkconfig.defaults.poll-stepper
```kconfig
# Bench overlay: poll the LEESN IG28ET stepper drive over RS-485 (CN1).
# Link settings discovered by the scan profile: 115200 8N1, unit ID 1.
# Reads FC03 holding reg 0x1015 (4117) = feedback-position LOW word (Leadshine iEM-RS map),
# once per second, for the hand-turn map-validation test: turn the shaft -> the count should
# track the turn (closed-loop drives only). Read-only & safe: this never writes a control
# register (no motion commanded). 0x1014 (4116) is the matching high word.
CONFIG_APP_MODBUS_POLL_ON_BOOT=y
CONFIG_APP_MODBUS_POLL_UNIT=1
CONFIG_APP_MODBUS_POLL_BAUD=115200
CONFIG_APP_MODBUS_POLL_FC=3
CONFIG_APP_MODBUS_POLL_REG=4117
CONFIG_APP_MODBUS_POLL_FLOAT=n
```

## firmware/sdkconfig.defaults.scan
```kconfig
# Bench profile: build the Modbus bus scanner instead of the normal LoRaWAN app.
# Usage:
#   idf.py -DSDKCONFIG_DEFAULTS="sdkconfig.defaults;sdkconfig.defaults.scan" build flash monitor
# Scans RS-485 (CN1) unit IDs sweeping common bauds x {8N1,8E1,8O1} and logs which answer.
# Probe register 6 = MFM384 linkcheck holding reg (40007); a Modbus exception still counts as
# present, so this also discovers other devices. Widen ID range below if unit 1-10 finds nothing.
CONFIG_APP_MODBUS_SCAN_ON_BOOT=y
CONFIG_APP_MODBUS_SCAN_ID_LO=1
CONFIG_APP_MODBUS_SCAN_ID_HI=10
CONFIG_APP_MODBUS_SCAN_TIMEOUT_MS=300
CONFIG_APP_MODBUS_SCAN_PROBE_REG=6
```

## firmware/sdkconfig.defaults.scan-stepper
```kconfig
# Bench profile: Modbus RTU bus scanner tuned for a LEESN IG28ET / Leadshine iEM-RS-class
# integrated stepper drive (holding registers, FC03). Build/flash:
#   idf.py -DSDKCONFIG_DEFAULTS="sdkconfig.defaults;sdkconfig.defaults.scan-stepper" build flash monitor
# Sweeps unit IDs 1-31 x {9600,4800,19200,38400,57600,115200} x {8N1,8E1,8O1}, probing FC03 reg
# 0x0191 (401 = peak current, a known-readable holding reg). A Modbus exception also counts as
# present. Drive factory defaults: Slave ID 1, baud 38400 (or 115200), parity configurable.
CONFIG_APP_MODBUS_SCAN_ON_BOOT=y
CONFIG_APP_MODBUS_SCAN_ID_LO=1
CONFIG_APP_MODBUS_SCAN_ID_HI=31
CONFIG_APP_MODBUS_SCAN_TIMEOUT_MS=300
CONFIG_APP_MODBUS_SCAN_PROBE_REG=401
```

## firmware/sdkconfig.defaults.scanner
```kconfig
# Scanner-station firmware variant (P0): layers on top of sdkconfig.defaults.
# Build with: idf.py -C firmware -D SDKCONFIG_DEFAULTS="sdkconfig.defaults;sdkconfig.defaults.scanner" build
# Enables the read-only RS-485 scan-* discovery console the Pi scanner drives. The provisioning
# console (default y) is required and stays on. No other behaviour changes vs the default image.
CONFIG_APP_SCAN_CONSOLE=y
```

## firmware/sdkconfig.defaults.sim-mfm384
```kconfig
# Bench profile: SIMULATED MFM384 field app — no meter needed, uplinks to ChirpStack.
# Usage (home lab, with CRM ChirpStack 10.10.8.140 in range):
#   idf.py -DSDKCONFIG_DEFAULTS="sdkconfig.defaults;sdkconfig.defaults.sim-mfm384" build flash monitor
# Joins OTAA then uplinks synthesized MFM384 telemetry (~230V 3-phase, ~5kW, climbing kWh, ~50Hz,
# ~0.95 PF), every 60 s, ADR-005 payload, flagged SIMULATED. Verify decode with
# tools/chirpstack_mfm384_decoder.js. No RS-485 init in this mode.
CONFIG_APP_FIELD_SIMULATE=y
CONFIG_APP_FIELD_DEVICE_MFM384=y
CONFIG_APP_FIELD_SAMPLE_INTERVAL_S=60
```

## firmware/sdkconfig.defaults.sim-profile
```kconfig
# Bench profile: PROFILE-DRIVEN SIMULATION — validate ANY provisioned device profile end-to-end over
# LoRaWAN with NO physical meter (EEM400/DSE/MFM384/...). Provision the profile blob first
# (prov-profile <hex> from device-profiles/profile_to_blob.py), then build+flash this:
#   idf.py -DSDKCONFIG_DEFAULTS="sdkconfig.defaults;sdkconfig.defaults.sim-profile" build flash monitor
# The field app skips the Modbus scan/read, joins immediately, and uplinks dp_simulate() data per the
# profile (SIMULATED flag set) — decode it with device-profiles/chirpstack_fleet_decoder.js.
# With no profile provisioned it falls back to the compiled MFM384 simulator.
CONFIG_APP_FIELD_SIMULATE=y
CONFIG_APP_FIELD_SAMPLE_INTERVAL_S=60
```

## firmware/sdkconfig.defaults.sim-rsfsjt
```kconfig
# Bench profile: SIMULATED RS-FSJT field app — no sensor needed, uplinks to ChirpStack.
# Usage:
#   idf.py -DSDKCONFIG_DEFAULTS="sdkconfig.defaults;sdkconfig.defaults.sim-rsfsjt" build flash monitor
# Joins OTAA then uplinks synthesized wind speed (0.5..9.5 m/s) every 60 s, ADR-005 payload, flagged
# SIMULATED. Decoder shows device "RS-FSJT-N01". No RS-485 init in this mode.
CONFIG_APP_FIELD_SIMULATE=y
CONFIG_APP_FIELD_DEVICE_RSFSJT=y
CONFIG_APP_FIELD_SAMPLE_INTERVAL_S=60
```

## firmware/sdkconfig.defaults.slave-sim
```kconfig
# EEM400 Modbus RTU slave emulation — bench fixture for the Pi scanner station's P5 gate.
# Build: idf.py -C firmware -D SDKCONFIG_DEFAULTS="sdkconfig.defaults;sdkconfig.defaults.slave-sim" build
# Flash to a spare careflow board and wire its CN1 to a scanner node's CN1; the scanner then
# discovers + profiles it blind. Answers FC03 with the Honeywell EEM400 register map. Not field firmware.
CONFIG_APP_MODBUS_SLAVE_SIM=y
CONFIG_APP_SLAVE_SIM_UNIT=3
CONFIG_APP_SLAVE_SIM_BAUD=9600
```

## firmware/sdkconfig.defaults.wdt-test
```kconfig
# Phase 7a watchdog-gate repro profile. Build/flash with:
#   idf.py -DSDKCONFIG_DEFAULTS="sdkconfig.defaults;sdkconfig.defaults.wdt-test" build flash monitor
# Simulated field data (no meter needed) so the field loop runs; short interval + short watchdog
# timeout; the loop deliberately stops feeding the TWDT after 2 cycles so it fires and the chip
# resets — the next boot logs reset reason "task-WDT" and increments the NVS boot counter.
# NEVER flash a production node with this profile (CONFIG_APP_DEBUG_WDT_STARVE).
CONFIG_APP_FIELD_SIMULATE=y
CONFIG_APP_FIELD_SAMPLE_INTERVAL_S=10
CONFIG_APP_TASK_WDT_TIMEOUT_S=10
CONFIG_APP_DEBUG_WDT_STARVE=y
CONFIG_APP_DEBUG_WDT_STARVE_AFTER=2
```
