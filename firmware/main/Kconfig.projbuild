## firmware/main/Kconfig.projbuild
```kconfig
menu "rak3112-rs485-node app"

config APP_MODBUS_SCAN_ON_BOOT
    bool "Bench: run a Modbus RTU bus scan at boot (instead of LoRaWAN)"
    default n
    help
        Bring-up tool. When set, app_main initialises RS-485 and scans Modbus unit IDs
        (sweeping common baud rates, starting at 9600 8N1), logging which IDs answer —
        a valid reply OR a Modbus exception both count as "present". It does NOT join
        LoRaWAN in this mode. Leave OFF for normal field firmware.

config APP_MODBUS_SCAN_ID_LO
    int "Scan: lowest unit ID"
    depends on APP_MODBUS_SCAN_ON_BOOT
    range 1 247
    default 1
    help
        Modbus unit IDs are 1-247; ID 0 is broadcast (never replies), so the scan starts at 1.

config APP_MODBUS_SCAN_ID_HI
    int "Scan: highest unit ID"
    depends on APP_MODBUS_SCAN_ON_BOOT
    range 1 247
    default 10

config APP_MODBUS_SCAN_TIMEOUT_MS
    int "Scan: per-probe response timeout (ms)"
    depends on APP_MODBUS_SCAN_ON_BOOT
    range 50 2000
    default 300

config APP_MODBUS_SCAN_PROBE_REG
    int "Scan: FC03 probe register (wire address)"
    depends on APP_MODBUS_SCAN_ON_BOOT
    default 0
    help
        Holding-register wire address each probe reads (1 register, FC03). 0 is fine for most
        devices; for a SELEC MFM384 use its linkcheck register 6 (40007), which is a known-good
        readable holding register. A Modbus *exception* still counts the device as present, so the
        exact address rarely matters for discovery.

config APP_MODBUS_POLL_ON_BOOT
    bool "Bench: continuously poll one Modbus register at boot (instead of LoRaWAN)"
    default n
    help
        Bring-up tool. Reads one register set from a fixed unit at 1 Hz (8N1) and logs the value
        (or timeout/exception). Supports FC03 (holding) / FC04 (input) and, for meters like the
        SELEC MFM384, a 32-bit IEEE-754 float spanning 2 registers. Use for live A/B-swap / wiring
        trial-and-error against a known device. Does NOT join LoRaWAN. Leave OFF for field firmware.

config APP_MODBUS_POLL_UNIT
    int "Poll: unit ID"
    depends on APP_MODBUS_POLL_ON_BOOT
    range 1 247
    default 1

config APP_MODBUS_POLL_BAUD
    int "Poll: baud rate"
    depends on APP_MODBUS_POLL_ON_BOOT
    default 9600
    help
        SELEC MFM384 bench default is 9600 8N1; the RS-FSJT-N01 wind sensor uses 4800.

config APP_MODBUS_POLL_FC
    int "Poll: function code (3 = holding, 4 = input registers)"
    depends on APP_MODBUS_POLL_ON_BOOT
    range 3 4
    default 3
    help
        MFM384 linkcheck/endianness registers are FC03; its float measurands (e.g. total active
        energy at 30090) are FC04 input registers.

config APP_MODBUS_POLL_REG
    int "Poll: register wire address"
    depends on APP_MODBUS_POLL_ON_BOOT
    default 6
    help
        Wire address (40007 -> 6, 30090 -> 89). Default 6 = MFM384 linkcheck holding register.

config APP_MODBUS_POLL_FLOAT
    bool "Poll: interpret 2 registers as an IEEE-754 float32"
    depends on APP_MODBUS_POLL_ON_BOOT
    default n
    help
        When set, the poll reads 2 registers and decodes a float32 (e.g. MFM384 energy in kWh).
        When clear, it reads a single uint16.

config APP_MODBUS_POLL_FLOAT_CDAB
    bool "Poll: float word order is CDAB (word-swapped) instead of ABCD"
    depends on APP_MODBUS_POLL_FLOAT
    default n
    help
        ABCD (default) = big-endian word order; MFM384 reports this (endianness register 40070 = 1).
        Set CDAB only if the reading looks like garbage (wrong word order on some PLCs/meters).

# ---------------------------------------------------------------------------
# Field application (Phase 6c): sample a device -> encode -> LoRaWAN uplink.
# This is the NORMAL firmware path (when neither scan nor poll bench mode is set).
# ---------------------------------------------------------------------------

config APP_FIELD_SIMULATE
    bool "Field app: use SIMULATED sensor data (no Modbus hardware needed)"
    default n
    help
        When set, the field app synthesizes plausible, time-varying measurements instead of reading
        a real device over Modbus, and tags uplinks with the SIMULATED flag. Use to exercise the
        full sample -> payload -> LoRaWAN -> ChirpStack path with no meter attached. RS-485 is not
        initialised in this mode. Leave OFF for real field firmware.

choice APP_FIELD_DEVICE
    prompt "Field app: device to sample / simulate"
    default APP_FIELD_DEVICE_MFM384
    help
        Selects which device model the field app samples and which payload it emits.

config APP_FIELD_DEVICE_MFM384
    bool "SELEC MFM384 energy meter (FC04, CDAB, 9600 8N1)"

config APP_FIELD_DEVICE_RSFSJT
    bool "RS-FSJT-N01 wind sensor (FC03 reg 0, 4800 8N1)"

endchoice

config APP_FIELD_UNIT
    int "Field app: Modbus unit ID"
    range 1 247
    default 1

config APP_FIELD_BAUD
    int "Field app: Modbus baud rate (real mode)"
    default 9600
    help
        MFM384 = 9600; RS-FSJT-N01 = 4800. Ignored in simulate mode.

config APP_FIELD_SAMPLE_INTERVAL_S
    int "Field app: sample + uplink interval (seconds)"
    range 10 3600
    default 60
    help
        AS923 dwell + fair-use friendly. Keep >= 60 for normal operation.

# ---------------------------------------------------------------------------
# Phase 7a — resilience: task-watchdog timeout + a debug starve path for the gate.
# ---------------------------------------------------------------------------

config APP_TASK_WDT_TIMEOUT_S
    int "Resilience: task-watchdog timeout (seconds)"
    range 5 300
    default 15
    help
        The field-app task subscribes to the Task Watchdog Timer and feeds it at least every 2 s
        (the inter-sample sleep is fed in 2 s chunks). This timeout must exceed that 2 s feed period
        plus worst-case Modbus + LoRaWAN uplink time. 15 s is a safe bench default; revisit once
        light-sleep duty-cycling lands (Phase 7b) if the feed cadence changes.

config APP_DEBUG_WDT_STARVE
    bool "Debug: stop feeding the task watchdog after a few cycles (7a gate)"
    default n
    help
        Phase 7a smoke-gate aid. When set, the field-app loop deliberately stops feeding the Task
        Watchdog after APP_DEBUG_WDT_STARVE_AFTER cycles and holds, so the TWDT fires and resets the
        chip — proving the watchdog is armed (the next boot logs reset reason "task-WDT"). NEVER ship
        with this set.

config APP_DEBUG_WDT_STARVE_AFTER
    int "Debug: cycles before starving the watchdog"
    depends on APP_DEBUG_WDT_STARVE
    range 1 20
    default 3

# ---------------------------------------------------------------------------
# Phase 7d — provisioning: NVS-stored credentials + runtime config.
# ---------------------------------------------------------------------------

config APP_PROVISIONING_CONSOLE
    bool "Provisioning: enable the USB-Serial-JTAG prov-* console"
    default y
    help
        Starts a small REPL (prov-lorawan / prov-modbus / prov-show / prov-clear / prov-done) that
        writes the NVS 'prov' namespace — OTAA credentials + Modbus field config — additively
        (nonces/session preserved). It is available in field mode too, so a deployed node can be
        re-pointed (baud/interval/meter) or re-keyed without erasing NVS. An unprovisioned node
        waits here until creds are written. Turn OFF only for a locked build whose credentials are
        compiled in or already in NVS (no field re-provisioning).

# ---------------------------------------------------------------------------
# Phase 7b — power: light-sleep duty-cycling between samples.
# ---------------------------------------------------------------------------

config APP_LIGHT_SLEEP
    bool "Power: light-sleep between samples (duty-cycle)"
    default n
    help
        Between sample+uplink cycles the field loop enters manual light-sleep (CPU + peripherals
        gated, RTC timer wake) instead of a busy vTaskDelay. RAM is retained, so the LoRaWAN session
        survives (no re-join). The sleep is chunked so the task watchdog keeps getting fed; while it
        is on, the idle-task watchdog is disabled (manual light-sleep freezes idle by design).

        DEFAULT OFF (Phase 7b): verify on a DC/battery bench with USB DISCONNECTED before enabling
        by default. With the board USB-powered and the USB-Serial-JTAG console active (VBUS present),
        esp_light_sleep_start() does not behave cleanly on this ESP32-S3 — the node runs cycle 0 then
        the console goes dark and cycling can't be observed/confirmed over USB. Field nodes run on
        battery/DC (no VBUS), which is also the only setup that measures true average current (the
        7b power gate, OQ-12). Enable + verify there.

# ---------------------------------------------------------------------------
# Phase 7c — OTA: build tag + a debug bad-image path for the rollback gate.
# ---------------------------------------------------------------------------

config APP_BUILD_TAG
    string "OTA: firmware build tag (logged at boot)"
    default "A"
    help
        A short label logged at boot (and via ota-status) to tell builds apart during OTA tests —
        e.g. build A into ota_0, build B activated into ota_1.

config APP_DEBUG_OTA_BAD
    bool "Debug: abort at boot before mark-valid (7c rollback gate)"
    default n
    help
        Builds a deliberately-broken image that aborts in app_main BEFORE marking itself valid, so
        activating it via OTA leaves it PENDING_VERIFY; on the post-crash reboot the bootloader
        rolls back to the previous good slot. NEVER ship with this set.

# ---------------------------------------------------------------------------
# Bench: WS2812 "alive" heartbeat (power bring-up aid).
# ---------------------------------------------------------------------------

config APP_LED_HEARTBEAT
    bool "Bench: WS2812 'alive' heartbeat (skip LoRa/Modbus/sleep)"
    default n
    help
        Standalone bench mode: drives the onboard WS2812 (GPIO38) as a breathing heartbeat and does
        nothing else — no LoRaWAN, no Modbus, no provisioning, no light-sleep. Use it to confirm the
        board is powered and running from ANY supply (DC1 barrel / USB-C / power bank) WITHOUT a USB
        host: a visible colour pulse = alive. Leave OFF for field firmware.

endmenu
```

## firmware/sdkconfig.defaults
```kconfig
CONFIG_IDF_TARGET="esp32s3"
CONFIG_ESPTOOLPY_FLASHSIZE_16MB=y

# Phase 2 EC-6: PSRAM enabled in Octal SPI mode.
# Source: Espressif ESP32-S3 Series Datasheet v2.2 Table 1-1.
# All 8 MB PSRAM ESP32-S3 SKUs (R8 / R8V) ship Octal — no 8 MB Quad SKU exists.
# Functional verification deferred to Phase 3 first-flash via boot-log signature
# (ADR-001 §"Expected boot-log signature for Octal PSRAM").
CONFIG_SPIRAM=y
CONFIG_SPIRAM_MODE_OCT=y

# Phase 3 first-flash finding (2026-06-20): the RAK3112 native USB (USB_D±, enumerates
# as /dev/cu.usbmodem*) is the ESP32-S3 USB-Serial-JTAG controller — the same path esptool
# flashes over. The Phase-1 CONFIG_ESP_CONSOLE_USB_CDC (OTG/TinyUSB) produced no visible
# console; USB-Serial-JTAG is the correct console for this board. Supersedes the USB_CDC choice.
CONFIG_ESP_CONSOLE_USB_SERIAL_JTAG=y
CONFIG_BOOTLOADER_LOG_LEVEL_INFO=y

# Phase 5 fix (2026-06-22): 1 kHz FreeRTOS tick for RadioLib LoRaWAN timing.
# RadioLib's LoRaWANNode::transmitUplink waits for TxDone with sleepDelay(toa) followed by a
# scanGuard=10 ms poll of digitalRead(DIO1). sleepDelay falls back to vTaskDelay(pdMS_TO_TICKS),
# so at the ESP-IDF default 100 Hz (10 ms) tick the air-time wait quantizes/undershoots by up to
# one tick — the DIO1 poll starts before the real TxDone and the 10 ms guard expires first →
# RADIOLIB_ERR_TX_TIMEOUT (-5). 1 ms ticks make the wait accurate to ~1 ms (well inside the 10 ms
# guard) and also tighten the RX1/RX2 window alignment. Matches RadioLib's ESP-IDF LoRaWAN guidance.
CONFIG_FREERTOS_HZ=1000

# Phase 7a (2026-06-25) — resilience. The Task Watchdog is initialised at boot; the field-app task
# subscribes to it and feeds it (the runtime timeout is reconfigured from CONFIG_APP_TASK_WDT_TIMEOUT_S).
# Brownout detector kept ENABLED at the IDF ESP32-S3 default level (LVL_SEL_7) so a sagging 3V3 rail
# forces a clean, logged reset (reset cause printed at the next boot) instead of undefined behaviour.
# Raise the BOD level only if the 7a soak shows rail margin — too high causes spurious resets on the
# RT6160 rail.
CONFIG_ESP_TASK_WDT_INIT=y
CONFIG_ESP_BROWNOUT_DET=y
CONFIG_ESP_BROWNOUT_DET_LVL_SEL_7=y

# Phase 7c (2026-06-25) — OTA: dual-slot partition table + bootloader app rollback. The custom
# partitions.csv keeps nvs at 0x9000/0x6000 so the 7d provisioning + LoRaWAN nonces survive the
# layout change (no full erase). Rollback: an image booted via esp_ota_set_boot_partition runs in
# PENDING_VERIFY; if it reboots without esp_ota_mark_app_valid_cancel_rollback (e.g. it crashed),
# the bootloader reverts to the previous good slot.
CONFIG_PARTITION_TABLE_CUSTOM=y
CONFIG_PARTITION_TABLE_CUSTOM_FILENAME="partitions.csv"
CONFIG_BOOTLOADER_APP_ROLLBACK_ENABLE=y
```

## firmware/sdkconfig.defaults.dump-stepper
```kconfig
# Bench overlay: read-only Modbus register-discovery dump of the IG28ET (CN1, 115200 8N1 unit 1).
# Sweeps FC03 across candidate blocks and logs non-zero registers — reverse-engineer the real map.
# Read-only: no FC06, no motion.
CONFIG_APP_MODBUS_DUMP_ON_BOOT=y
CONFIG_APP_MODBUS_DUMP_UNIT=1
CONFIG_APP_MODBUS_DUMP_BAUD=115200
```

## firmware/sdkconfig.defaults.field-rsfsjt
```kconfig
# Bench profile: REAL RS-FSJT-N01 field app — read the wind sensor + uplink to ChirpStack.
# Usage (home lab, sensor on CN1 + CRM ChirpStack in range):
#   idf.py -DSDKCONFIG_DEFAULTS="sdkconfig.defaults;sdkconfig.defaults.field-rsfsjt" build flash monitor
# Reads RS-FSJT (FC03 holding reg 0, uint16, /10 = m/s) at 4800 8N1 unit 1, encodes the ADR-005
# RS-FSJT payload, and uplinks every 60 s. A failed read uplinks a STALE-flagged payload.
CONFIG_APP_FIELD_DEVICE_RSFSJT=y
CONFIG_APP_FIELD_UNIT=1
CONFIG_APP_FIELD_BAUD=4800
CONFIG_APP_FIELD_SAMPLE_INTERVAL_S=60
```

## firmware/sdkconfig.defaults.jog-stepper
```kconfig
# Bench overlay: console-driven JOG of the LEESN IG28ET stepper drive over RS-485 (CN1).
# MOVES THE MOTOR (FC06 writes). Boots IDLE; the shaft turns only on a typed jog command,
# each bounded to 1-5 s and auto-stopped. Link params from the scan: 115200 8N1, unit 1.
# Use ONLY with the motor mechanically safe (secured, unloaded, current-limited).
# Commands over the USB-Serial-JTAG console: mot-read / mot-enable / mot-disable /
# jog-fwd [s] / jog-rev [s] / jog-stop.
CONFIG_APP_MODBUS_JOG_CONSOLE=y
CONFIG_APP_MODBUS_JOG_UNIT=1
CONFIG_APP_MODBUS_JOG_BAUD=115200
```

## firmware/sdkconfig.defaults.led-heartbeat
```kconfig
# Bench profile: WS2812 "alive" heartbeat — confirm the board powers from ANY supply (DC1 barrel /
# USB-C / power bank) with no USB host. Drives GPIO38 only; no LoRa/Modbus/provisioning/sleep.
#   idf.py -DSDKCONFIG_DEFAULTS="sdkconfig.defaults;sdkconfig.defaults.led-heartbeat" build flash
# Flash once over USB, then run the board on the external supply — a breathing colour pulse = alive.
CONFIG_APP_LED_HEARTBEAT=y
```

## firmware/sdkconfig.defaults.lightsleep-led
```kconfig
# Phase 7b diagnostic: light-sleep ON + a per-cycle WS2812 wake-flash. On an external supply, a
# green flash every interval = the node is WAKING and cycling (no host/console needed); one flash
# then dark = it hung in light-sleep. Has a tiny per-cycle current blip — drop the LED for the
# clean average-current run.
CONFIG_APP_LIGHT_SLEEP=y
CONFIG_APP_FIELD_LED_BLINK=y
```
